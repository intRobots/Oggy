// Подключаем библиотеку которая поможет управлять моторами
#include <Servo.h>
// Подключим файлы с описанием роботов
#include "Robot.h"

// Делаем своего робота Огги! (можно другое имя)
Robot Oggy;

// То что робот будет делать во время включения
void setup() {
  // Робот становится на ножки под указанніми углами и готов работать
  Oggy.Start(87, 70);
  delay(2000);
}
 
// То что робот будет делать всегда
void loop() {
  return;
  // Проверка, есть ли опасность
  if (Oggy.Danger()) {
    // Если есть, то:
    Oggy.Walk(-10);       // робот пугается, делая шаг назад;
    delay(700);           // выжидает 0,7 секунд;
    while (Oggy.Danger()) { // смотрит, если сохраняется опасность,
      Oggy.Walk(-8);      // продолжает убегать назад со скоростью 8
    }
    delay(1400);          // выжидает 0,7 секунд;
  }

  // Проверка расстояния до препятствия
  if (Oggy.Distance() > 15) {
    // Если оно больше 15 см, робот идет
    Oggy.Walk(4);
    Serial.println("walk");
  } else {
    // а если меньше, останавливается
    Oggy.Stop();
    Serial.println("stop");
  }
}
